## modules/tinyframe/Kconfig
```kconfig
config ZEPHYR_TINYFRAME_MODULE
	bool

menuconfig TINYFRAME
	bool "Tinyframe Support"
	help
		This option enables the Tinyframe library.

if TINYFRAME

endif # TINYFRAME
```

## west.yml
```yaml
# Copyright (c) 2021 Nordic Semiconductor ASA
# SPDX-License-Identifier: Apache-2.0

manifest:
  self:
    path: cerebri
    west-commands: scripts/west-commands.yml

  projects:
    - name: zephyr
      url: https://github.com/zephyrproject-rtos/zephyr
      west-commands: scripts/west-commands.yml
      revision: v3.3.0
      clone-depth: 1
      import:
        - name-allowlist:
          - nanopb
          - mbedtls
          - net-tools
    - name: tinyframe
      url: https://github.com/MightyPork/TinyFrame
      revision: a29167a
      clone-depth: 1
      path: cerebri/modules/tinyframe/TinyFrame
    - name: ponyframe
      url: https://github.com/MightyPork/PonyFrame.git
      revision: c932b20
      path: cerebri/tools/ponyframe
```
